/*
* Fritz Reese
*
* Here we use the PRU output pins to manually PWM each color pin as necessary.
* We use P9.29-P9.31 (PRU0 outputs 0-2) for the LEDs, and
* P9.26 (PRU1 input 16) for the IR sensor.
*
*/

/dts-v1/;
/plugin/;

/{
  compatible = "ti,beaglebone", "ti,beaglebone-black";
  part-number = "CIRCLS_pruss";
  version = "00A0";

  exclusive-use = "P9.26", "P9.28", "P9.29", "P9.30", "P9.31", "pru0", "pru1";

  fragment@0 {
    target = <&am33xx_pinmux>;
    __overlay__ {
      circls_pru_pins: CIRCLS_pruss {
        pinctrl-single,pins = <
          0x180 0x36  // P9_26 PINS$96  PR1_PRU1_PRU_R31_16, input
          0x19c 0x36  // P9_28 PINS$103 PR1_PRU0_PRU_R31_3,  input
          0x194 0x05  // P9_29 PINS$101 PR1_PRU0_PRU_R30_1
          0x198 0x05  // P9_30 PINS$102 PR1_PRU0_PRU_R30_2
          0x190 0x05  // P9_31 PINS$100 PR1_PRU0_PRU_R30_0
        >;
      };
    };
  };

  fragment@1 {
    target = <&pruss>;
    __overlay__ {
      status = "okay";
      pinctrl-names = "default";
      pinctrl-0 = <&circls_pru_pins>;
    };
  };

};
